// maze_game.cpp — Maze puzzle for badge_v2.
//
// RIGHT eye: scrolling viewport centred on the player, camera follows.
// LEFT eye:  move counter (playing) / size index 1/3–3/3 (size selector).
//
// Controls (edge-triggered):
//   LEFT   → rotate player counter-clockwise
//   RIGHT  → rotate player clockwise
//   CENTER → move forward one cell (hold for auto-repeat)
//
// Win : reach the exit (top-right corner).
// Lose: exceed sMaxMoves without finding the exit.
//
// mazeGameStart(cols, rows) — 0,0 = show size selector (menu mode).
// Maze generated by iterative DFS (randomised), a fresh maze each game.

#include "maze_game.h"
#include "game_result.h"
#include "minigame_ui.h"
#include "inactivity.h"
#include "../hal/buttons.h"
#include "../hal/leds.h"
#include "../hal/display.h"
#include "../hal/buzzer.h"
#include "../config/hardware.h"
#include "../eyes/eye_geometry.h"
#include "../sound/rtttl.h"
#include <Arduino.h>
#include <esp_random.h>
#include <algorithm>

namespace {

// ── Grid bounds (compile-time maxima) ────────────────────────────────────────
constexpr uint8_t  kMaxCols  = 32;
constexpr uint8_t  kMaxRows  = 20;
constexpr uint8_t  kCell     =  5;          // cell interior size in px
constexpr uint8_t  kStep     =  kCell + 1;  // 6 px per slot (cell + 1-px wall)
constexpr int16_t  kScrW     = 128;
constexpr int16_t  kScrH     =  64;

constexpr uint32_t kAnimMs          = 1500;
constexpr uint32_t kCdStepMs        =  700;
constexpr uint32_t kGoMs            =  700;
constexpr int16_t  kTextY           =   38;
constexpr uint32_t kHoldInitDelayMs =  350;  // delay before auto-repeat starts
constexpr uint32_t kHoldRepeatMs    =  120;  // interval between repeated moves

// ── Size presets (menu mode selector) ────────────────────────────────────────
struct SizePreset { uint8_t cols; uint8_t rows; uint16_t maxMoves; const char* label; };
constexpr SizePreset kSizes[3] = {
    { 10, 10, 300, "PETIT" },
    { 20, 14, 500, "MOYEN" },
    { 32, 20, 800, "GRAND" },
};

// ── Runtime maze dimensions ───────────────────────────────────────────────────
static uint8_t  sCols     = kMaxCols;
static uint8_t  sRows     = kMaxRows;
static uint16_t sMaxMoves = 500;

// ── Wall storage ──────────────────────────────────────────────────────────────
// sVWall[r] bit c = wall to the RIGHT of cell (c, r).
// sHWall[r] bit c = wall BELOW cell (c, r)  (between row r and r+1).
static uint32_t sVWall[kMaxRows];
static uint32_t sHWall[kMaxRows];

static bool wallRight(uint8_t c, uint8_t r) { return (sVWall[r] >> c) & 1u; }
static bool wallBelow(uint8_t c, uint8_t r) { return (sHWall[r] >> c) & 1u; }

// ── DFS maze generation ───────────────────────────────────────────────────────
struct DCell { uint8_t c, r; };
static DCell    sDfsStack[kMaxCols * kMaxRows];
static uint32_t sVisited[kMaxRows];

static void generateMaze() {
    const uint8_t startCol = 0;
    const uint8_t startRow = (uint8_t)(sRows - 1);
    for (uint8_t r = 0; r < sRows; ++r) {
        sVWall[r]   = 0xFFFFFFFFu;
        sHWall[r]   = 0xFFFFFFFFu;
        sVisited[r] = 0;
    }

    uint16_t top = 0;
    sVisited[startRow] |= (1u << startCol);
    sDfsStack[top++] = { startCol, startRow };

    while (top > 0) {
        DCell cur = sDfsStack[top - 1];

        DCell nb[4];
        uint8_t n = 0;
        if (cur.r > 0       && !(sVisited[cur.r-1] & (1u << cur.c)))        nb[n++] = { cur.c,               (uint8_t)(cur.r - 1) };
        if (cur.r < sRows-1 && !(sVisited[cur.r+1] & (1u << cur.c)))        nb[n++] = { cur.c,               (uint8_t)(cur.r + 1) };
        if (cur.c > 0       && !(sVisited[cur.r]   & (1u << (cur.c - 1))))  nb[n++] = { (uint8_t)(cur.c - 1), cur.r              };
        if (cur.c < sCols-1 && !(sVisited[cur.r]   & (1u << (cur.c + 1))))  nb[n++] = { (uint8_t)(cur.c + 1), cur.r              };

        if (n == 0) { --top; continue; }

        DCell next = nb[esp_random() % n];

        if (next.c == cur.c) {
            uint8_t topRow = (next.r < cur.r) ? next.r : cur.r;
            sHWall[topRow] &= ~(1u << cur.c);
        } else {
            uint8_t leftCol = (next.c < cur.c) ? next.c : cur.c;
            sVWall[cur.r]  &= ~(1u << leftCol);
        }

        sVisited[next.r] |= (1u << next.c);
        sDfsStack[top++] = next;
    }
}

// ── Player ────────────────────────────────────────────────────────────────────
enum Dir : uint8_t { DirUp = 0, DirRight = 1, DirDown = 2, DirLeft = 3 };

static uint8_t  sPCol, sPRow;
static Dir      sPDir;
static uint16_t sMoves;
static InactivityTimer sInactivity;

// ── Camera ────────────────────────────────────────────────────────────────────
// Centre viewport on player. For mazes smaller than the screen, centre the maze.
static void computeCamera(int16_t& camX, int16_t& camY) {
    camX = (int16_t)sPCol * kStep + kStep / 2 - kScrW / 2;
    camY = (int16_t)sPRow * kStep + kStep / 2 - kScrH / 2 - 10;
}

// ── Player movement ───────────────────────────────────────────────────────────
static bool canMove(Dir d) {
    switch (d) {
        case DirUp:    return sPRow > 0          && !wallBelow(sPCol, sPRow - 1);
        case DirDown:  return sPRow < sRows - 1  && !wallBelow(sPCol, sPRow);
        case DirRight: return sPCol < sCols - 1  && !wallRight(sPCol, sPRow);
        case DirLeft:  return sPCol > 0          && !wallRight(sPCol - 1, sPRow);
    }
    return false;
}

static void doMove() {
    if (!canMove(sPDir)) return;
    switch (sPDir) {
        case DirUp:    --sPRow; break;
        case DirDown:  ++sPRow; break;
        case DirRight: ++sPCol; break;
        case DirLeft:  --sPCol; break;
    }
    ++sMoves;
}

// ── Phase / state ─────────────────────────────────────────────────────────────
enum class Phase : uint8_t { SizeSelect, Countdown, GoCue, Playing, SuccessAnim, FailAnim, Done };

static bool     sActive         = false;
static Phase    sPhase          = Phase::Countdown;
static uint8_t  sCdCount        = 3;
static uint32_t sNextMs         = 0;
static uint32_t sPhaseEndMs     = 0;
static bool     sPrevBtn[3];
static uint32_t sCenterHeldMs   = 0;
static uint32_t sLastAutoMoveMs = 0;
static uint8_t  sSizeIdx        = 1;  // default MOYEN

// ── LED helpers ───────────────────────────────────────────────────────────────
static void clearAllLeds() {
    for (uint8_t i = 0; i < kLedTotal; ++i) gLedStrip.setPixelColor(i, 0);
}
static void syncLeds(uint32_t nowMs) {
    clearAllLeds();
    minigameUiPaintTourFlashIfActive(nowMs);
    gLedStrip.show();
}

// ── Drawing ───────────────────────────────────────────────────────────────────

static void drawMazeViewport(int16_t camX, int16_t camY) {
    const int16_t mazeW = (int16_t)sCols * kStep + 1;
    const int16_t mazeH = (int16_t)sRows * kStep + 1;
    gRightDisplay.fillRect(-camX, -camY, mazeW, mazeH, SSD1306_WHITE);

    int16_t fcol = (camX > 0) ? (int16_t)(camX / kStep)            : 0;
    int16_t lcol = std::min((int16_t)((camX + kScrW) / kStep),     (int16_t)(sCols - 1));
    int16_t frow = (camY > 0) ? (int16_t)(camY / kStep)            : 0;
    int16_t lrow = std::min((int16_t)((camY + kScrH) / kStep),     (int16_t)(sRows - 1));

    for (int16_t r = frow; r <= lrow; ++r) {
        for (int16_t c = fcol; c <= lcol; ++c) {
            int16_t sx = c * kStep + 1 - camX;
            int16_t sy = r * kStep + 1 - camY;
            gRightDisplay.fillRect(sx, sy, kCell, kCell, SSD1306_BLACK);
            if (c < sCols - 1 && !wallRight((uint8_t)c, (uint8_t)r))
                gRightDisplay.fillRect(sx + kCell, sy, 1, kCell, SSD1306_BLACK);
            if (r < sRows - 1 && !wallBelow((uint8_t)c, (uint8_t)r))
                gRightDisplay.fillRect(sx, sy + kCell, kCell, 1, SSD1306_BLACK);
        }
    }
}

static void drawExit(int16_t camX, int16_t camY) {
    const uint8_t exitCol = sCols - 1;
    const uint8_t exitRow = 0;
    int16_t sx = (int16_t)exitCol * kStep + 1 - camX;
    int16_t sy = (int16_t)exitRow * kStep + 1 - camY;
    gRightDisplay.drawRect(sx + 1, sy + 1, kCell - 2, kCell - 2, SSD1306_WHITE);
}

static void drawPlayer(int16_t camX, int16_t camY) {
    int16_t sx = (int16_t)sPCol * kStep + 1 - camX;
    int16_t sy = (int16_t)sPRow * kStep + 1 - camY;
    int16_t cx = sx + 2, cy = sy + 2;
    switch (sPDir) {
        case DirUp:
            gRightDisplay.fillTriangle(cx,   sy,   sx,   sy+4, sx+4, sy+4, SSD1306_WHITE); break;
        case DirDown:
            gRightDisplay.fillTriangle(cx,   sy+4, sx,   sy,   sx+4, sy,   SSD1306_WHITE); break;
        case DirRight:
            gRightDisplay.fillTriangle(sx+4, cy,   sx,   sy,   sx,   sy+4, SSD1306_WHITE); break;
        case DirLeft:
            gRightDisplay.fillTriangle(sx,   cy,   sx+4, sy,   sx+4, sy+4, SSD1306_WHITE); break;
    }
}

static void drawLeftMoves(uint32_t nowMs) {
    EyeUiGeom g;
    if (!eyeUiBeginFrame(gLeftDisplay, false, nowMs, &g)) return;
    char buf[6];
    snprintf(buf, sizeof(buf), "%u", (unsigned)sMoves);
    eyeUiDrawRotatedKeyword(gLeftDisplay, &g, buf);
    gLeftDisplay.display();
}

static void drawGameField(uint32_t nowMs) {
    int16_t camX, camY;
    computeCamera(camX, camY);
    gRightDisplay.clearDisplay();
    drawMazeViewport(camX, camY);
    drawExit(camX, camY);
    drawPlayer(camX, camY);
    gRightDisplay.display();
    drawLeftMoves(nowMs);
}

static void drawSizeSelect(uint32_t nowMs) {
    EyeUiGeom g;
    // Right eye: size label
    if (eyeUiBeginFrame(gRightDisplay, true, nowMs, &g)) {
        eyeUiDrawTextCenteredNudged(gRightDisplay, kTextY, 2, kSizes[sSizeIdx].label);
        gRightDisplay.display();
    }
    // Left eye: index indicator (1/3, 2/3, 3/3)
    if (eyeUiBeginFrame(gLeftDisplay, false, nowMs, &g)) {
        char idx[4];
        snprintf(idx, sizeof(idx), "%d/3", sSizeIdx + 1);
        eyeUiDrawRotatedKeyword(gLeftDisplay, &g, idx);
        gLeftDisplay.display();
    }
}

static void drawPhaseUi(uint32_t nowMs) {
    EyeUiGeom g;
    switch (sPhase) {
        case Phase::SizeSelect:
            drawSizeSelect(nowMs);
            break;
        case Phase::Countdown:
            if (!eyeUiBeginFrame(gRightDisplay, true, nowMs, &g)) break;
            { char d[2] = { (char)('0' + sCdCount), '\0' };
              eyeUiDrawTextCenteredNudged(gRightDisplay, kTextY, 2, d, 0); }
            gRightDisplay.display();
            drawLeftMoves(nowMs);
            break;
        case Phase::GoCue:
            if (!eyeUiBeginFrame(gRightDisplay, true, nowMs, &g)) break;
            eyeUiDrawTextCenteredNudged(gRightDisplay, kTextY, 2, "GO", 0);
            gRightDisplay.display();
            drawLeftMoves(nowMs);
            break;
        case Phase::Playing:
            drawGameField(nowMs);
            break;
        case Phase::SuccessAnim:
            minigameUiDrawWinBothEyes(nowMs);
            break;
        case Phase::FailAnim:
            minigameUiDrawLoseBothEyes(nowMs);
            break;
        case Phase::Done:
            break;
    }
}

}  // namespace

// ── Public API ────────────────────────────────────────────────────────────────

// cols=0, rows=0  → show size selector (menu mode, 3 choices)
// cols>0, rows>0  → start directly with given size (tama mode)
void mazeGameStart(uint8_t cols, uint8_t rows) {
    rtttlStop();
    clearAllLeds();
    gLedStrip.show();

    sActive = true;
    sPrevBtn[0] = gButtonPressedLatched[0];
    sPrevBtn[1] = gButtonPressedLatched[1];
    sPrevBtn[2] = gButtonPressedLatched[2];
    sCenterHeldMs   = 0;
    sLastAutoMoveMs = 0;

    const uint32_t t = millis();

    if (cols == 0 || rows == 0) {
        // Menu mode: show size selector
        sSizeIdx  = 1;  // default MOYEN
        sPhase    = Phase::SizeSelect;
        drawPhaseUi(t);
        syncLeds(t);
        return;
    }

    // Fixed size (tama mode or any direct call)
    sCols     = (cols > kMaxCols) ? kMaxCols : cols;
    sRows     = (rows > kMaxRows) ? kMaxRows : rows;
    sMaxMoves = (uint16_t)((uint16_t)sCols * sRows * 2u);
    if (sMaxMoves < 200) sMaxMoves = 200;

    generateMaze();
    sPCol  = 0;
    sPRow  = (uint8_t)(sRows - 1);
    sPDir  = DirUp;
    sMoves = 0;

    sPhase   = Phase::Countdown;
    sCdCount = 3;
    sInactivity.reset(t);
    sNextMs = t + kCdStepMs;
    drawPhaseUi(t);
    syncLeds(t);
}

void mazeGameStop() {
    if (!sActive) return;
    sActive = false;
    sPhase  = Phase::Countdown;
    rtttlStop();
    clearAllLeds();
    gLedStrip.show();
}

bool mazeGameIsActive() { return sActive; }

void mazeGameTick(uint32_t nowMs) {
    if (!sActive) return;

    if (sPhase == Phase::SuccessAnim) {
        drawPhaseUi(nowMs);
        syncLeds(nowMs);
        if (nowMs >= sPhaseEndMs) { gGameResult = GameResult::Won;  mazeGameStop(); }
        return;
    }
    if (sPhase == Phase::FailAnim) {
        drawPhaseUi(nowMs);
        syncLeds(nowMs);
        if (nowMs >= sPhaseEndMs) { gGameResult = GameResult::Lost; mazeGameStop(); }
        return;
    }

    // ── Size selector ─────────────────────────────────────────────────────────
    if (sPhase == Phase::SizeSelect) {
        bool edgeL = gButtonPressedLatched[kBtnLeft]   && !sPrevBtn[0];
        bool edgeC = gButtonPressedLatched[kBtnCenter] && !sPrevBtn[1];
        bool edgeR = gButtonPressedLatched[kBtnRight]  && !sPrevBtn[2];
        sPrevBtn[0] = gButtonPressedLatched[kBtnLeft];
        sPrevBtn[1] = gButtonPressedLatched[kBtnCenter];
        sPrevBtn[2] = gButtonPressedLatched[kBtnRight];

        if (edgeL) sSizeIdx = (uint8_t)((sSizeIdx + 2u) % 3u);
        if (edgeR) sSizeIdx = (uint8_t)((sSizeIdx + 1u) % 3u);
        if (edgeC) {
            sCols     = kSizes[sSizeIdx].cols;
            sRows     = kSizes[sSizeIdx].rows;
            sMaxMoves = kSizes[sSizeIdx].maxMoves;
            generateMaze();
            sPCol  = 0;
            sPRow  = (uint8_t)(sRows - 1);
            sPDir  = DirUp;
            sMoves = 0;
            sCenterHeldMs   = 0;
            sLastAutoMoveMs = 0;
            sPhase   = Phase::Countdown;
            sCdCount = 3;
            sNextMs  = nowMs + kCdStepMs;
            sInactivity.reset(nowMs);
        }
        drawPhaseUi(nowMs);
        syncLeds(nowMs);
        return;
    }

    if (sPhase == Phase::GoCue) {
        drawPhaseUi(nowMs);
        syncLeds(nowMs);
        if (nowMs >= sNextMs) sPhase = Phase::Playing;
        return;
    }
    if (sPhase == Phase::Countdown) {
        drawPhaseUi(nowMs);
        syncLeds(nowMs);
        if (nowMs >= sNextMs) {
            if (sCdCount <= 1) { sPhase = Phase::GoCue; sNextMs = nowMs + kGoMs; }
            else               { --sCdCount; sNextMs = nowMs + kCdStepMs; }
        }
        return;
    }

    // ── Playing ───────────────────────────────────────────────────────────────
    bool edgeL = gButtonPressedLatched[kBtnLeft]   && !sPrevBtn[0];
    bool edgeC = gButtonPressedLatched[kBtnCenter] && !sPrevBtn[1];
    bool edgeR = gButtonPressedLatched[kBtnRight]  && !sPrevBtn[2];
    sPrevBtn[0] = gButtonPressedLatched[kBtnLeft];
    sPrevBtn[1] = gButtonPressedLatched[kBtnCenter];
    sPrevBtn[2] = gButtonPressedLatched[kBtnRight];

    if (edgeL || edgeC || edgeR) sInactivity.reset(nowMs);
    InactivityState inact = sInactivity.tick(nowMs);
    if (inact == InactivityState::Timeout) { mazeGameStop(); return; }

    if (edgeL) sPDir = (Dir)((sPDir + 3u) % 4u);
    if (edgeR) sPDir = (Dir)((sPDir + 1u) % 4u);

    // CENTER: immediate move on press edge + auto-repeat while held
    if (edgeC) {
        doMove();
        sCenterHeldMs   = nowMs;
        sLastAutoMoveMs = nowMs;
    } else if (gButtonState[kBtnCenter]) {
        if (sCenterHeldMs == 0) sCenterHeldMs = nowMs;
        if (nowMs - sCenterHeldMs >= kHoldInitDelayMs
                && nowMs - sLastAutoMoveMs >= kHoldRepeatMs) {
            doMove();
            sLastAutoMoveMs = nowMs;
            sInactivity.reset(nowMs);
        }
    } else {
        sCenterHeldMs = 0;
    }

    const uint8_t exitCol = sCols - 1;
    const uint8_t exitRow = 0;
    if (sPCol == exitCol && sPRow == exitRow) {
        rtttlStart("win:d=16,o=5,b=200:16g,16e,16g,16c6");
        minigameUiArmTourFlashGreen(nowMs, 700);
        sPhase      = Phase::SuccessAnim;
        sPhaseEndMs = nowMs + kAnimMs;
    } else if (sMoves >= sMaxMoves) {
        rtttlStart("go:d=8,o=3,b=200:8c,8c");
        minigameUiArmTourFlashRed(nowMs, 700);
        sPhase      = Phase::FailAnim;
        sPhaseEndMs = nowMs + kAnimMs;
    }

    drawPhaseUi(nowMs);
    if (inact == InactivityState::Warning)
        minigameUiDrawInactivityWarning(nowMs, sInactivity.secondsLeft(nowMs));
    syncLeds(nowMs);
}
